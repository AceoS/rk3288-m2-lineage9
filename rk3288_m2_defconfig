## rk3288_m2_defconfig
```kconfig
CONFIG_ARCH_ROCKCHIP=y
CONFIG_MACH_RK3288=y
CONFIG_ARM=y
CONFIG_BRCMFMAC=m
CONFIG_BRCMFMAC_SDIO=y
CONFIG_CFG80211=y
CONFIG_DRM_ROCKCHIP=y
CONFIG_DRM_ROCKCHIP_LVDS=y
CONFIG_MALI_MIDGARD=y
CONFIG_ION_ROCKCHIP=y
```
